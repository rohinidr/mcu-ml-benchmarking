#include "model_runner.h"
#include "model_config.h"
#include "benchmark.h"

/* Test vectors — generated by model/convert.py --export-test-vectors N */
#include "test_vectors.h"

void setup()
{
    Serial.begin(115200);
    while (!Serial) {}

    model_init();

    benchmark_stats_t stats;
    benchmark_stats_init(&stats);

    for (int i = 0; i < TEST_COUNT; i++) {
        int8_t output[MODEL_NUM_CLASSES];
        model_run(test_inputs[i], output);

        int pred = 0;
        for (int j = 1; j < MODEL_NUM_CLASSES; j++)
            if (output[j] > output[pred]) pred = j;

        float conf = MODEL_OUTPUT_SCALE * (output[pred] - MODEL_OUTPUT_ZERO_POINT);

        benchmark_result_t r = {
            .inference_time_us = model_inference_time_us(),
            .predicted_class   = pred,
            .true_label        = test_labels[i],
            .confidence        = conf,
        };
        benchmark_stats_update(&stats, &r);
    }

    benchmark_print_csv("Arduino-Nano33", &stats);
}

void loop() {}
